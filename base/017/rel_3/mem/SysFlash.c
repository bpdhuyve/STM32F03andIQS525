//================================================================================================//
// M O D U L E   H E A D E R
//------------------------------------------------------------------------------------------------//
// Implementation of the flash manipulation
//
// Copyright (c), PsiControl Mechatronics NV, All rights reserved.
//================================================================================================//
#define MEM__SYSFLASH_C
//================================================================================================//



//================================================================================================//
// V E R I F Y    C O N F I G U R A T I O N
//------------------------------------------------------------------------------------------------//
#include "AppConfig.h"
//------------------------------------------------------------------------------------------------//
// @brief  Defines the log level of the module
#ifndef MEM__SYSFLASH_LOG_LEVEL
	#define CORELOG_LEVEL               LOG_LEVEL_NONE
#else
	#define CORELOG_LEVEL               MEM__SYSFLASH_LOG_LEVEL
#endif
//================================================================================================//



//================================================================================================//
// I N C L U D E S
//------------------------------------------------------------------------------------------------//
#include "Core.h"

// SYS
#include "mem\SysFlash.h"
#include "core\stm32f0xx_flash.h"
//================================================================================================//



//================================================================================================//
// L O C A L   D E F I N I T I O N S   A N D   M A C R O S
//------------------------------------------------------------------------------------------------//
//================================================================================================//



//================================================================================================//
// L O C A L   T Y P E D E F S
//------------------------------------------------------------------------------------------------//
//================================================================================================//



//================================================================================================//
// L O C A L   F U N C T I O N   P R O T O T Y P E S
//------------------------------------------------------------------------------------------------//
//================================================================================================//



//================================================================================================//
// L O C A L   V A R I A B L E S
//------------------------------------------------------------------------------------------------//
//================================================================================================//



//================================================================================================//
// E X P O R T E D   V A R I A B L E S
//------------------------------------------------------------------------------------------------//
//================================================================================================//



//================================================================================================//
// L O C A L   F U N C T I O N S
//------------------------------------------------------------------------------------------------//
//================================================================================================//


//================================================================================================//
// E X P O R T E D   F U N C T I O N S
//------------------------------------------------------------------------------------------------//
void SysFlash_Init(void)
{
    FLASH_Unlock();
}
//------------------------------------------------------------------------------------------------//
BOOL SysFlash_Clear(U32 address)
{
    return (BOOL)(FLASH_ErasePage(address) == FLASH_COMPLETE);
}
//------------------------------------------------------------------------------------------------//
BOOL SysFlash_Write(U32 address, U8* data_ptr, U32 len)
{
    if((address & 0x01) || (len & 0x01))
    {
        LOG_WRN("Address and length must be 16-bit aligned");
        return FALSE;
    }
    
    while(len)
    {
        if(FLASH_ProgramHalfWord(address, *((U16*)data_ptr)) != FLASH_COMPLETE)
        {
            return FALSE;
        }
        len -= 2;
        address += 2;
        data_ptr += 2;
    }
    return TRUE;
}
//================================================================================================//
