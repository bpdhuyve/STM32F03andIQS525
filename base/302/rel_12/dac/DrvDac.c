//================================================================================================//
// M O D U L E   H E A D E R
//------------------------------------------------------------------------------------------------//
// Implementation of the common part of the SPI Master Channel driver
//
// Copyright (c), PsiControl Mechatronics NV, All rights reserved.
//================================================================================================//
#define DAC__DRVDAC_C
//================================================================================================//



//================================================================================================//
// V E R I F Y    C O N F I G U R A T I O N
//------------------------------------------------------------------------------------------------//
#include "AppConfig.h"
//------------------------------------------------------------------------------------------------//
// @brief  Defines the log level of the module
#ifndef DAC__DRVDAC_LOG_LEVEL
	#define CORELOG_LEVEL               LOG_LEVEL_NONE
#else
	#define CORELOG_LEVEL               DAC__DRVDAC_LOG_LEVEL
#endif
//================================================================================================//



//================================================================================================//
// I N C L U D E S
//------------------------------------------------------------------------------------------------//
#include "Core.h"

//DRV include section
#include "dac\DrvDac.h"
//================================================================================================//



//================================================================================================//
// L O C A L   D E F I N I T I O N S   A N D   M A C R O S
//------------------------------------------------------------------------------------------------//
//================================================================================================//



//================================================================================================//
// L O C A L   T Y P E D E F S
//------------------------------------------------------------------------------------------------//
//================================================================================================//



//================================================================================================//
// L O C A L   F U N C T I O N   P R O T O T Y P E S
//------------------------------------------------------------------------------------------------//
//================================================================================================//



//================================================================================================//
// L O C A L   V A R I A B L E S
//------------------------------------------------------------------------------------------------//
//================================================================================================//



//================================================================================================//
// E X P O R T E D   V A R I A B L E S
//------------------------------------------------------------------------------------------------//
//================================================================================================//



//================================================================================================//
// L O C A L   F U N C T I O N S
//------------------------------------------------------------------------------------------------//
//================================================================================================//


//================================================================================================//
// E X P O R T E D   F U N C T I O N S
//------------------------------------------------------------------------------------------------//
void DrvDac_Init(void)
{
    LOG_DEV("DrvDac_Init");
}
//-------------------------------------------------------------------------------------//
BOOL DrvDac_SetValue(DAC_CHANNEL_HNDL channel_hndl, U16 dac_value)
{
    LOG_DEV("DrvDac_SetValue");
    if((channel_hndl != NULL) && (channel_hndl->hook_list_ptr != NULL) && (channel_hndl->hook_list_ptr->set_value_hook != NULL))
    {
        if(channel_hndl->hook_list_ptr->set_value_hook(channel_hndl->channel_id, dac_value))
        {
            return TRUE;
        }
        LOG_WRN("Failed to set value");
        return FALSE;
    }
    LOG_WRN("DAC set function is NULL");
    return FALSE;
}
//-------------------------------------------------------------------------------------//
BOOL DrvDac_GetValue(DAC_CHANNEL_HNDL channel_hndl, U16* dac_value)
{
    LOG_DEV("DrvDac_SetValue");
    if((channel_hndl != NULL) && (channel_hndl->hook_list_ptr != NULL) && (channel_hndl->hook_list_ptr->get_value_hook != NULL))
    {
        if(channel_hndl->hook_list_ptr->get_value_hook(channel_hndl->channel_id, dac_value))
        {
            return TRUE;
        }
        LOG_WRN("Failed to get value");
        return FALSE;
    }
    LOG_WRN("DAC get function is NULL");
    return FALSE;
}
//================================================================================================//
