//================================================================================================//
// M O D U L E   H E A D E R
//------------------------------------------------------------------------------------------------//
// Implementation of the common part of the SPI Master Channel driver
//
// Copyright (c), PsiControl Mechatronics NV, All rights reserved.
//================================================================================================//
#define ADC__DRVADC_C
//================================================================================================//



//================================================================================================//
// V E R I F Y    C O N F I G U R A T I O N
//------------------------------------------------------------------------------------------------//
#include "AppConfig.h"
//------------------------------------------------------------------------------------------------//
// @brief  Defines the log level of the module
#ifndef ADC__DRVADC_LOG_LEVEL
	#define CORELOG_LEVEL               LOG_LEVEL_NONE
#else
	#define CORELOG_LEVEL               ADC__DRVADC_LOG_LEVEL
#endif
//================================================================================================//



//================================================================================================//
// I N C L U D E S
//------------------------------------------------------------------------------------------------//
#include "Core.h"

//DRV include section
#include "adc\DrvAdc.h"
//================================================================================================//



//================================================================================================//
// L O C A L   D E F I N I T I O N S   A N D   M A C R O S
//------------------------------------------------------------------------------------------------//
//================================================================================================//



//================================================================================================//
// L O C A L   T Y P E D E F S
//------------------------------------------------------------------------------------------------//
//================================================================================================//



//================================================================================================//
// L O C A L   F U N C T I O N   P R O T O T Y P E S
//------------------------------------------------------------------------------------------------//
//================================================================================================//



//================================================================================================//
// L O C A L   V A R I A B L E S
//------------------------------------------------------------------------------------------------//
static ADC_CHANNEL_HNDL                     drvadc_active_hndl;
static BOOL                                 drvadc_conversion_complete;
//================================================================================================//



//================================================================================================//
// E X P O R T E D   V A R I A B L E S
//------------------------------------------------------------------------------------------------//
//================================================================================================//



//================================================================================================//
// L O C A L   F U N C T I O N S
//------------------------------------------------------------------------------------------------//
//================================================================================================//


//================================================================================================//
// E X P O R T E D   F U N C T I O N S
//------------------------------------------------------------------------------------------------//
void DrvAdc_Init(void)
{
    LOG_DEV("DrvAdc_Init");
    drvadc_active_hndl = NULL;
    drvadc_conversion_complete = FALSE;
}
//------------------------------------------------------------------------------------------------//
BOOL DrvAdc_RegisterConversionComplete(ADC_CHANNEL_HNDL channel_hndl, EVENT_CALLBACK conversion_complete_callback)
{
    LOG_DEV("DrvAdc_RegisterMsgComplete");
    if(channel_hndl != NULL)
    {
        channel_hndl->conversion_complete_callback = conversion_complete_callback;
        return TRUE;
    }
    return FALSE;
}
//------------------------------------------------------------------------------------------------//
BOOL DrvAdc_StartConversion(ADC_CHANNEL_HNDL channel_hndl, U16* value_ptr, BOOL wait_for_result)
{
    LOG_DEV("DrvAdc_StartConversion");
    if((channel_hndl != NULL) && (channel_hndl->hook_list_ptr != NULL) && (channel_hndl->hook_list_ptr->start_conversion_hook != NULL))
    {
        if(wait_for_result)
        {
            if(drvadc_active_hndl != NULL)  // can only wait for 1 conversion
            {
                return FALSE;
            }
            drvadc_active_hndl = channel_hndl;
            drvadc_conversion_complete = FALSE;
        }
        if(channel_hndl->hook_list_ptr->start_conversion_hook(channel_hndl->channel_id, value_ptr))
        {
            if(wait_for_result)
            {
                while(drvadc_conversion_complete == FALSE)
                {}
                drvadc_active_hndl = NULL;
            }
            return TRUE;
        }
        LOG_WRN("Failed to start conversion");
        return FALSE;
    }
    LOG_WRN("ADC start function is NULL");
    return FALSE;
}
//------------------------------------------------------------------------------------------------//
void DrvAdc_ConversionComplete(ADC_CHANNEL_HNDL channel_hndl)
{
    LOG_DEV("DrvAdc_ConversionComplete");
    if(drvadc_active_hndl == channel_hndl)
    {
        drvadc_conversion_complete = TRUE;
    }
    if(channel_hndl->conversion_complete_callback != NULL)
    {
        channel_hndl->conversion_complete_callback();
    }
}
//================================================================================================//
