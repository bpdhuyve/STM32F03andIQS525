//================================================================================================//
// M O D U L E   H E A D E R
//------------------------------------------------------------------------------------------------//
// gpio abstraction driver
//
// Copyright (c), PsiControl Mechatronics NV, All rights reserved.
//================================================================================================//
#define GPIO__DRVGPIO_C
//================================================================================================//



//================================================================================================//
// V E R I F Y    C O N F I G U R A T I O N
//------------------------------------------------------------------------------------------------//
#include "AppConfig.h"
//------------------------------------------------------------------------------------------------//
// @brief  Defines the log level of the module
#ifndef GPIO__DRVGPIO_LOG_LEVEL
	#define CORELOG_LEVEL               LOG_LEVEL_NONE
#else
	#define CORELOG_LEVEL               GPIO__DRVGPIO_LOG_LEVEL
#endif
//================================================================================================//



//================================================================================================//
// I N C L U D E S
//------------------------------------------------------------------------------------------------//
#include "Core.h"

//DRV lib include section
#include "gpio\DrvGpio.h"
//================================================================================================//



//================================================================================================//
// L O C A L   D E F I N I T I O N S   A N D   M A C R O S
//------------------------------------------------------------------------------------------------//
//================================================================================================//



//================================================================================================//
// L O C A L   T Y P E D E F S
//------------------------------------------------------------------------------------------------//
//================================================================================================//



//================================================================================================//
// L O C A L   F U N C T I O N   P R O T O T Y P E S
//------------------------------------------------------------------------------------------------//
//================================================================================================//



//================================================================================================//
// L O C A L   V A R I A B L E S
//------------------------------------------------------------------------------------------------//
//================================================================================================//



//================================================================================================//
// E X P O R T E D   V A R I A B L E S
//------------------------------------------------------------------------------------------------//
//================================================================================================//



//================================================================================================//
// I M P O R T E D   V A R I A B L E S   A N D   F U N C T I O N S
//------------------------------------------------------------------------------------------------//
//================================================================================================//



//================================================================================================//
// L O C A L   F U N C T I O N S
//------------------------------------------------------------------------------------------------//
//================================================================================================//



//================================================================================================//
// E X P O R T E D   F U N C T I O N S
//------------------------------------------------------------------------------------------------//
void DrvGpio_Init(void)
{
    //register module stuff indien nodig
    //...
}
//------------------------------------------------------------------------------------------------//
void DrvGpio_ReInitPin(DRVGPIO_PIN_HNDL pin_hndl, GPIO_PIN_FUNCTION function)
{
    if((pin_hndl != NULL) && (pin_hndl->hook_list_ptr != NULL) && (pin_hndl->hook_list_ptr->re_init_hook != NULL))
    {
        //if pin is defined as GPIO_PIN_OUTPUT_START_HIGH try to set pin already to high before init as output
        if(function == GPIO_PIN_OUTPUT_START_HIGH)
        {
            DrvGpio_SetPin(pin_hndl, TRUE);
        }
        
        //call int hook
        pin_hndl->hook_list_ptr->re_init_hook(pin_hndl->pin_id, function);
        
        //if pin is defined as GPIO_PIN_OUTPUT_START_HIGH set pin again to high level because some processors will have failed the first time
        if(function == GPIO_PIN_OUTPUT_START_HIGH)
        {
            DrvGpio_SetPin(pin_hndl, TRUE);
        }
        return;
    }
    LOG_WRN("GPIO init function is NULL");
    return;
}
//------------------------------------------------------------------------------------------------//
void DrvGpio_SetPin(DRVGPIO_PIN_HNDL pin_hndl, BOOL value)
{
    if((pin_hndl != NULL) && (pin_hndl->hook_list_ptr != NULL) && (pin_hndl->hook_list_ptr->set_hook != NULL))
    {
        pin_hndl->hook_list_ptr->set_hook(pin_hndl->pin_id, value);
        return;
    }
    LOG_WRN("GPIO set function is NULL");
    return;
}
//------------------------------------------------------------------------------------------------//
BOOL DrvGpio_GetPin(DRVGPIO_PIN_HNDL pin_hndl)
{
    if((pin_hndl != NULL) && (pin_hndl->hook_list_ptr != NULL) && (pin_hndl->hook_list_ptr->get_hook != NULL))
    {
        return (pin_hndl->hook_list_ptr->get_hook(pin_hndl->pin_id));
    }
    LOG_WRN("GPIO get function is NULL");
    return FALSE;
}
//================================================================================================//
